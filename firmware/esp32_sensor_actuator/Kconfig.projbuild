## firmware/esp32_sensor_actuator/Kconfig.projbuild
```kconfig
menu "Wi-Fi configuration"

    config ESP_WIFI_SSID
        string "WiFi SSID"
        default "ssid123"
        help
            SSID (network name) for the example to connect to.

    config ESP_WIFI_PASSWORD
        string "WiFi Password"
        default "password123"
        help
            WiFi password for the example to use.
endmenu
```
